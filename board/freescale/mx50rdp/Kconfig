## board/freescale/mx50rdp/Kconfig
```kconfig
if TARGET_MX50RDP

config SYS_BOARD
	default "mx50rdp"

config SYS_VENDOR
	default "freescale"

config SYS_SOC
	default "mx5"

config SYS_CONFIG_NAME
	default "mx50rdp"

config IMX_CONFIG
	default "board/freescale/mx50rdp/imximage.cfg"

endif
```

## configs/mx50rdp_defconfig
```kconfig
CONFIG_ARM=y
CONFIG_ARCH_MX5=y
CONFIG_SYS_TEXT_BASE=0x77800000
CONFIG_TARGET_MX50RDP=y
CONFIG_MXC_UART=y
CONFIG_SYS_LOAD_ADDR=0x70800000
CONFIG_CMD_BMODE=n
```
